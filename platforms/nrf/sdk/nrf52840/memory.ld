/* Generated by the nRF Core build - do not edit.
 * QMK app image regions for nrf52840, from the core's devicetree
 * (qmk_partition, qmk_sram in socs/nrf52840.overlay). */
MEMORY
{
    APP_FLASH (rx)  : ORIGIN = 0x80000, LENGTH = 0x6a000
    APP_RAM   (rwx) : ORIGIN = 0x20030000, LENGTH = 0x10000
}
