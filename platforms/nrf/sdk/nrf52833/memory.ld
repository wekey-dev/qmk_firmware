/* Generated by the nRF Core build - do not edit.
 * QMK app image regions for nrf52833, from the core's devicetree
 * (qmk_partition, qmk_sram in socs/nrf52833.overlay). */
MEMORY
{
    APP_FLASH (rx)  : ORIGIN = 0x50000, LENGTH = 0x1d000
    APP_RAM   (rwx) : ORIGIN = 0x20018000, LENGTH = 0x8000
}
